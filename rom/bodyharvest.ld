SECTIONS
{
    __romPos = 0;
    header_ROM_START = __romPos;
    header_VRAM = ADDR(.header);
    .header : AT(header_ROM_START) SUBALIGN(16)
    {
        FILL(0x00000000);
        header_DATA_START = .;
        build/asm/header.o(.data);
        header_DATA_END = .;
        header_DATA_SIZE = ABSOLUTE(header_DATA_END - header_DATA_START);
    }
    __romPos += SIZEOF(.header);
    header_ROM_END = __romPos;
    header_VRAM_END = .;

    boot_ROM_START = __romPos;
    boot_VRAM = ADDR(.boot);
    .boot : AT(boot_ROM_START) SUBALIGN(16)
    {
        FILL(0x00000000);
        boot_DATA_START = .;
        build/assets/boot.o(.data);
        boot_DATA_END = .;
        boot_DATA_SIZE = ABSOLUTE(boot_DATA_END - boot_DATA_START);
    }
    __romPos += SIZEOF(.boot);
    boot_ROM_END = __romPos;
    boot_VRAM_END = .;

    entry_ROM_START = __romPos;
    entry_VRAM = ADDR(.entry);
    .entry 0x80000400 : AT(entry_ROM_START) SUBALIGN(16)
    {
        FILL(0x00000000);
        entry_TEXT_START = .;
        build/asm/1000.o(.text);
        . = ALIGN(., 16);
        entry_TEXT_END = .;
        entry_TEXT_SIZE = ABSOLUTE(entry_TEXT_END - entry_TEXT_START);
        entry_DATA_START = .;
        build/asm/1000.o(.data);
        . = ALIGN(., 16);
        entry_DATA_END = .;
        entry_DATA_SIZE = ABSOLUTE(entry_DATA_END - entry_DATA_START);
        entry_RODATA_START = .;
        build/asm/1000.o(.rodata);
        . = ALIGN(., 16);
        entry_RODATA_END = .;
        entry_RODATA_SIZE = ABSOLUTE(entry_RODATA_END - entry_RODATA_START);
    }
    entry_bss_VRAM = ADDR(.entry_bss);
    .entry_bss (NOLOAD) : SUBALIGN(16)
    {
        FILL(0x00000000);
        entry_BSS_START = .;
        build/asm/1000.o(.bss);
        . = ALIGN(., 16);
        entry_BSS_END = .;
        entry_BSS_SIZE = ABSOLUTE(entry_BSS_END - entry_BSS_START);
    }
    __romPos += SIZEOF(.entry);
    __romPos = ALIGN(__romPos, 16);
    . = ALIGN(., 16);
    entry_ROM_END = __romPos;
    entry_VRAM_END = .;

    main_ROM_START = __romPos;
    main_VRAM = ADDR(.main);
    .main entry_VRAM_END : AT(main_ROM_START) SUBALIGN(16)
    {
        FILL(0x00000000);
        main_TEXT_START = .;
        build/asm/1050.o(.text);
        build/asm/53D0.o(.text);
        build/asm/53F0.o(.text);
        build/asm/AD60.o(.text);
        build/asm/E830.o(.text);
        build/asm/FB00.o(.text);
        build/asm/10BC0.o(.text);
        build/asm/12C80.o(.text);
        build/asm/1B060.o(.text);
        build/asm/1B100.o(.text);
        build/asm/1B7E0.o(.text);
        build/asm/1BA60.o(.text);
        build/asm/1BA90.o(.text);
        build/asm/1BBE0.o(.text);
        build/asm/1C670.o(.text);
        build/asm/1C7B0.o(.text);
        build/asm/1C830.o(.text);
        build/asm/1C8E0.o(.text);
        build/asm/1C8F0.o(.text);
        build/asm/1D120.o(.text);
        build/asm/1D230.o(.text);
        build/asm/1D850.o(.text);
        build/asm/1D890.o(.text);
        build/asm/1D900.o(.text);
        build/asm/1DCC0.o(.text);
        build/asm/1DD30.o(.text);
        build/asm/1DDA0.o(.text);
        build/asm/1E1A0.o(.text);
        build/asm/1E2E0.o(.text);
        build/asm/1E540.o(.text);
        build/asm/1E550.o(.text);
        build/asm/1E7B0.o(.text);
        build/asm/1ECD0.o(.text);
        build/asm/1EF60.o(.text);
        build/asm/1F1F0.o(.text);
        build/asm/1F520.o(.text);
        build/asm/1F5C0.o(.text);
        build/asm/1F980.o(.text);
        build/asm/1F9F0.o(.text);
        build/asm/1FBD0.o(.text);
        build/asm/1FE70.o(.text);
        build/asm/1FEE0.o(.text);
        build/asm/1FF10.o(.text);
        build/asm/200D0.o(.text);
        build/asm/20150.o(.text);
        build/asm/201B0.o(.text);
        build/asm/202E0.o(.text);
        build/asm/202F0.o(.text);
        build/asm/20370.o(.text);
        build/asm/20420.o(.text);
        build/asm/20440.o(.text);
        build/asm/204A0.o(.text);
        build/asm/206F0.o(.text);
        build/asm/21920.o(.text);
        build/asm/22030.o(.text);
        build/asm/22070.o(.text);
        build/asm/22B30.o(.text);
        build/asm/22B70.o(.text);
        build/asm/22BB0.o(.text);
        build/asm/22C80.o(.text);
        build/asm/22D10.o(.text);
        build/asm/22D70.o(.text);
        build/asm/22DD0.o(.text);
        build/asm/22E30.o(.text);
        build/asm/22EA0.o(.text);
        build/asm/22F70.o(.text);
        build/asm/22FD0.o(.text);
        build/asm/23490.o(.text);
        build/asm/23740.o(.text);
        build/asm/237E0.o(.text);
        build/asm/23980.o(.text);
        build/asm/23B90.o(.text);
        build/asm/23C50.o(.text);
        build/asm/23C60.o(.text);
        build/asm/245F0.o(.text);
        build/asm/24A80.o(.text);
        build/asm/24B30.o(.text);
        build/asm/24C10.o(.text);
        build/asm/253E0.o(.text);
        build/asm/25480.o(.text);
        build/asm/26120.o(.text);
        build/asm/26420.o(.text);
        build/asm/27080.o(.text);
        build/asm/27190.o(.text);
        build/asm/273D0.o(.text);
        build/asm/27740.o(.text);
        build/asm/278B0.o(.text);
        build/asm/28140.o(.text);
        build/asm/281D0.o(.text);
        build/asm/282B0.o(.text);
        build/asm/28A90.o(.text);
        build/asm/28D00.o(.text);
        build/asm/28D90.o(.text);
        build/asm/28DB0.o(.text);
        build/asm/28E60.o(.text);
        build/asm/28EE0.o(.text);
        build/asm/28F40.o(.text);
        build/asm/28FA0.o(.text);
        build/asm/293C0.o(.text);
        build/asm/29500.o(.text);
        build/asm/29510.o(.text);
        build/asm/29870.o(.text);
        build/asm/29960.o(.text);
        build/asm/29A60.o(.text);
        build/asm/29E30.o(.text);
        build/asm/2BC00.o(.text);
        build/asm/2C010.o(.text);
        build/asm/2C160.o(.text);
        build/asm/2C1F0.o(.text);
        build/asm/2C420.o(.text);
        build/asm/2C560.o(.text);
        build/asm/2C5F0.o(.text);
        build/asm/2C690.o(.text);
        build/asm/2C720.o(.text);
        build/asm/2CFA0.o(.text);
        build/asm/2CFB0.o(.text);
        build/asm/2D2D0.o(.text);
        build/asm/2D310.o(.text);
        build/asm/2D3A0.o(.text);
        build/asm/2D3D0.o(.text);
        build/asm/2D400.o(.text);
        build/asm/2D420.o(.text);
        build/asm/2E070.o(.text);
        build/asm/2E0F0.o(.text);
        build/asm/2E120.o(.text);
        build/asm/2E230.o(.text);
        build/asm/2E240.o(.text);
        build/asm/2E2A0.o(.text);
        build/asm/2E2F0.o(.text);
        build/asm/2E390.o(.text);
        build/asm/2E3E0.o(.text);
        build/asm/2EAE0.o(.text);
        . = ALIGN(., 16);
        main_TEXT_END = .;
        main_TEXT_SIZE = ABSOLUTE(main_TEXT_END - main_TEXT_START);
        main_DATA_START = .;
        build/asm/1050.o(.data);
        build/asm/53D0.o(.data);
        build/asm/53F0.o(.data);
        build/asm/AD60.o(.data);
        build/asm/E830.o(.data);
        build/asm/FB00.o(.data);
        build/asm/10BC0.o(.data);
        build/asm/12C80.o(.data);
        build/asm/1B060.o(.data);
        build/asm/1B100.o(.data);
        build/asm/1B7E0.o(.data);
        build/asm/1BA60.o(.data);
        build/asm/1BA90.o(.data);
        build/asm/1BBE0.o(.data);
        build/asm/1C670.o(.data);
        build/asm/1C7B0.o(.data);
        build/asm/1C830.o(.data);
        build/asm/1C8E0.o(.data);
        build/asm/1C8F0.o(.data);
        build/asm/1D120.o(.data);
        build/asm/1D230.o(.data);
        build/asm/1D850.o(.data);
        build/asm/1D890.o(.data);
        build/asm/1D900.o(.data);
        build/asm/1DCC0.o(.data);
        build/asm/1DD30.o(.data);
        build/asm/1DDA0.o(.data);
        build/asm/1E1A0.o(.data);
        build/asm/1E2E0.o(.data);
        build/asm/1E540.o(.data);
        build/asm/1E550.o(.data);
        build/asm/1E7B0.o(.data);
        build/asm/1ECD0.o(.data);
        build/asm/1EF60.o(.data);
        build/asm/1F1F0.o(.data);
        build/asm/1F520.o(.data);
        build/asm/1F5C0.o(.data);
        build/asm/1F980.o(.data);
        build/asm/1F9F0.o(.data);
        build/asm/1FBD0.o(.data);
        build/asm/1FE70.o(.data);
        build/asm/1FEE0.o(.data);
        build/asm/1FF10.o(.data);
        build/asm/200D0.o(.data);
        build/asm/20150.o(.data);
        build/asm/201B0.o(.data);
        build/asm/202E0.o(.data);
        build/asm/202F0.o(.data);
        build/asm/20370.o(.data);
        build/asm/20420.o(.data);
        build/asm/20440.o(.data);
        build/asm/204A0.o(.data);
        build/asm/206F0.o(.data);
        build/asm/21920.o(.data);
        build/asm/22030.o(.data);
        build/asm/22070.o(.data);
        build/asm/22B30.o(.data);
        build/asm/22B70.o(.data);
        build/asm/22BB0.o(.data);
        build/asm/22C80.o(.data);
        build/asm/22D10.o(.data);
        build/asm/22D70.o(.data);
        build/asm/22DD0.o(.data);
        build/asm/22E30.o(.data);
        build/asm/22EA0.o(.data);
        build/asm/22F70.o(.data);
        build/asm/22FD0.o(.data);
        build/asm/23490.o(.data);
        build/asm/23740.o(.data);
        build/asm/237E0.o(.data);
        build/asm/23980.o(.data);
        build/asm/23B90.o(.data);
        build/asm/23C50.o(.data);
        build/asm/23C60.o(.data);
        build/asm/245F0.o(.data);
        build/asm/24A80.o(.data);
        build/asm/24B30.o(.data);
        build/asm/24C10.o(.data);
        build/asm/253E0.o(.data);
        build/asm/25480.o(.data);
        build/asm/26120.o(.data);
        build/asm/26420.o(.data);
        build/asm/27080.o(.data);
        build/asm/27190.o(.data);
        build/asm/273D0.o(.data);
        build/asm/27740.o(.data);
        build/asm/278B0.o(.data);
        build/asm/28140.o(.data);
        build/asm/281D0.o(.data);
        build/asm/282B0.o(.data);
        build/asm/28A90.o(.data);
        build/asm/28D00.o(.data);
        build/asm/28D90.o(.data);
        build/asm/28DB0.o(.data);
        build/asm/28E60.o(.data);
        build/asm/28EE0.o(.data);
        build/asm/28F40.o(.data);
        build/asm/28FA0.o(.data);
        build/asm/293C0.o(.data);
        build/asm/29500.o(.data);
        build/asm/29510.o(.data);
        build/asm/29870.o(.data);
        build/asm/29960.o(.data);
        build/asm/29A60.o(.data);
        build/asm/29E30.o(.data);
        build/asm/2BC00.o(.data);
        build/asm/2C010.o(.data);
        build/asm/2C160.o(.data);
        build/asm/2C1F0.o(.data);
        build/asm/2C420.o(.data);
        build/asm/2C560.o(.data);
        build/asm/2C5F0.o(.data);
        build/asm/2C690.o(.data);
        build/asm/2C720.o(.data);
        build/asm/2CFA0.o(.data);
        build/asm/2CFB0.o(.data);
        build/asm/2D2D0.o(.data);
        build/asm/2D310.o(.data);
        build/asm/2D3A0.o(.data);
        build/asm/2D3D0.o(.data);
        build/asm/2D400.o(.data);
        build/asm/2D420.o(.data);
        build/asm/2E070.o(.data);
        build/asm/2E0F0.o(.data);
        build/asm/2E120.o(.data);
        build/asm/2E230.o(.data);
        build/asm/2E240.o(.data);
        build/asm/2E2A0.o(.data);
        build/asm/2E2F0.o(.data);
        build/asm/2E390.o(.data);
        build/asm/2E3E0.o(.data);
        build/asm/2EAE0.o(.data);
        build/asm/data/2EC40.data.o(.data);
        . = ALIGN(., 16);
        main_DATA_END = .;
        main_DATA_SIZE = ABSOLUTE(main_DATA_END - main_DATA_START);
        main_RODATA_START = .;
        build/asm/1050.o(.rodata);
        build/asm/53D0.o(.rodata);
        build/asm/53F0.o(.rodata);
        build/asm/AD60.o(.rodata);
        build/asm/E830.o(.rodata);
        build/asm/FB00.o(.rodata);
        build/asm/10BC0.o(.rodata);
        build/asm/12C80.o(.rodata);
        build/asm/1B060.o(.rodata);
        build/asm/1B100.o(.rodata);
        build/asm/1B7E0.o(.rodata);
        build/asm/1BA60.o(.rodata);
        build/asm/1BA90.o(.rodata);
        build/asm/1BBE0.o(.rodata);
        build/asm/1C670.o(.rodata);
        build/asm/1C7B0.o(.rodata);
        build/asm/1C830.o(.rodata);
        build/asm/1C8E0.o(.rodata);
        build/asm/1C8F0.o(.rodata);
        build/asm/1D120.o(.rodata);
        build/asm/1D230.o(.rodata);
        build/asm/1D850.o(.rodata);
        build/asm/1D890.o(.rodata);
        build/asm/1D900.o(.rodata);
        build/asm/1DCC0.o(.rodata);
        build/asm/1DD30.o(.rodata);
        build/asm/1DDA0.o(.rodata);
        build/asm/1E1A0.o(.rodata);
        build/asm/1E2E0.o(.rodata);
        build/asm/1E540.o(.rodata);
        build/asm/1E550.o(.rodata);
        build/asm/1E7B0.o(.rodata);
        build/asm/1ECD0.o(.rodata);
        build/asm/1EF60.o(.rodata);
        build/asm/1F1F0.o(.rodata);
        build/asm/1F520.o(.rodata);
        build/asm/1F5C0.o(.rodata);
        build/asm/1F980.o(.rodata);
        build/asm/1F9F0.o(.rodata);
        build/asm/1FBD0.o(.rodata);
        build/asm/1FE70.o(.rodata);
        build/asm/1FEE0.o(.rodata);
        build/asm/1FF10.o(.rodata);
        build/asm/200D0.o(.rodata);
        build/asm/20150.o(.rodata);
        build/asm/201B0.o(.rodata);
        build/asm/202E0.o(.rodata);
        build/asm/202F0.o(.rodata);
        build/asm/20370.o(.rodata);
        build/asm/20420.o(.rodata);
        build/asm/20440.o(.rodata);
        build/asm/204A0.o(.rodata);
        build/asm/206F0.o(.rodata);
        build/asm/21920.o(.rodata);
        build/asm/22030.o(.rodata);
        build/asm/22070.o(.rodata);
        build/asm/22B30.o(.rodata);
        build/asm/22B70.o(.rodata);
        build/asm/22BB0.o(.rodata);
        build/asm/22C80.o(.rodata);
        build/asm/22D10.o(.rodata);
        build/asm/22D70.o(.rodata);
        build/asm/22DD0.o(.rodata);
        build/asm/22E30.o(.rodata);
        build/asm/22EA0.o(.rodata);
        build/asm/22F70.o(.rodata);
        build/asm/22FD0.o(.rodata);
        build/asm/23490.o(.rodata);
        build/asm/23740.o(.rodata);
        build/asm/237E0.o(.rodata);
        build/asm/23980.o(.rodata);
        build/asm/23B90.o(.rodata);
        build/asm/23C50.o(.rodata);
        build/asm/23C60.o(.rodata);
        build/asm/245F0.o(.rodata);
        build/asm/24A80.o(.rodata);
        build/asm/24B30.o(.rodata);
        build/asm/24C10.o(.rodata);
        build/asm/253E0.o(.rodata);
        build/asm/25480.o(.rodata);
        build/asm/26120.o(.rodata);
        build/asm/26420.o(.rodata);
        build/asm/27080.o(.rodata);
        build/asm/27190.o(.rodata);
        build/asm/273D0.o(.rodata);
        build/asm/27740.o(.rodata);
        build/asm/278B0.o(.rodata);
        build/asm/28140.o(.rodata);
        build/asm/281D0.o(.rodata);
        build/asm/282B0.o(.rodata);
        build/asm/28A90.o(.rodata);
        build/asm/28D00.o(.rodata);
        build/asm/28D90.o(.rodata);
        build/asm/28DB0.o(.rodata);
        build/asm/28E60.o(.rodata);
        build/asm/28EE0.o(.rodata);
        build/asm/28F40.o(.rodata);
        build/asm/28FA0.o(.rodata);
        build/asm/293C0.o(.rodata);
        build/asm/29500.o(.rodata);
        build/asm/29510.o(.rodata);
        build/asm/29870.o(.rodata);
        build/asm/29960.o(.rodata);
        build/asm/29A60.o(.rodata);
        build/asm/29E30.o(.rodata);
        build/asm/2BC00.o(.rodata);
        build/asm/2C010.o(.rodata);
        build/asm/2C160.o(.rodata);
        build/asm/2C1F0.o(.rodata);
        build/asm/2C420.o(.rodata);
        build/asm/2C560.o(.rodata);
        build/asm/2C5F0.o(.rodata);
        build/asm/2C690.o(.rodata);
        build/asm/2C720.o(.rodata);
        build/asm/2CFA0.o(.rodata);
        build/asm/2CFB0.o(.rodata);
        build/asm/2D2D0.o(.rodata);
        build/asm/2D310.o(.rodata);
        build/asm/2D3A0.o(.rodata);
        build/asm/2D3D0.o(.rodata);
        build/asm/2D400.o(.rodata);
        build/asm/2D420.o(.rodata);
        build/asm/2E070.o(.rodata);
        build/asm/2E0F0.o(.rodata);
        build/asm/2E120.o(.rodata);
        build/asm/2E230.o(.rodata);
        build/asm/2E240.o(.rodata);
        build/asm/2E2A0.o(.rodata);
        build/asm/2E2F0.o(.rodata);
        build/asm/2E390.o(.rodata);
        build/asm/2E3E0.o(.rodata);
        build/asm/2EAE0.o(.rodata);
        . = ALIGN(., 16);
        main_RODATA_END = .;
        main_RODATA_SIZE = ABSOLUTE(main_RODATA_END - main_RODATA_START);
    }
    main_bss_VRAM = ADDR(.main_bss);
    .main_bss (NOLOAD) : SUBALIGN(16)
    {
        FILL(0x00000000);
        main_BSS_START = .;
        build/asm/1050.o(.bss);
        build/asm/53D0.o(.bss);
        build/asm/53F0.o(.bss);
        build/asm/AD60.o(.bss);
        build/asm/E830.o(.bss);
        build/asm/FB00.o(.bss);
        build/asm/10BC0.o(.bss);
        build/asm/12C80.o(.bss);
        build/asm/1B060.o(.bss);
        build/asm/1B100.o(.bss);
        build/asm/1B7E0.o(.bss);
        build/asm/1BA60.o(.bss);
        build/asm/1BA90.o(.bss);
        build/asm/1BBE0.o(.bss);
        build/asm/1C670.o(.bss);
        build/asm/1C7B0.o(.bss);
        build/asm/1C830.o(.bss);
        build/asm/1C8E0.o(.bss);
        build/asm/1C8F0.o(.bss);
        build/asm/1D120.o(.bss);
        build/asm/1D230.o(.bss);
        build/asm/1D850.o(.bss);
        build/asm/1D890.o(.bss);
        build/asm/1D900.o(.bss);
        build/asm/1DCC0.o(.bss);
        build/asm/1DD30.o(.bss);
        build/asm/1DDA0.o(.bss);
        build/asm/1E1A0.o(.bss);
        build/asm/1E2E0.o(.bss);
        build/asm/1E540.o(.bss);
        build/asm/1E550.o(.bss);
        build/asm/1E7B0.o(.bss);
        build/asm/1ECD0.o(.bss);
        build/asm/1EF60.o(.bss);
        build/asm/1F1F0.o(.bss);
        build/asm/1F520.o(.bss);
        build/asm/1F5C0.o(.bss);
        build/asm/1F980.o(.bss);
        build/asm/1F9F0.o(.bss);
        build/asm/1FBD0.o(.bss);
        build/asm/1FE70.o(.bss);
        build/asm/1FEE0.o(.bss);
        build/asm/1FF10.o(.bss);
        build/asm/200D0.o(.bss);
        build/asm/20150.o(.bss);
        build/asm/201B0.o(.bss);
        build/asm/202E0.o(.bss);
        build/asm/202F0.o(.bss);
        build/asm/20370.o(.bss);
        build/asm/20420.o(.bss);
        build/asm/20440.o(.bss);
        build/asm/204A0.o(.bss);
        build/asm/206F0.o(.bss);
        build/asm/21920.o(.bss);
        build/asm/22030.o(.bss);
        build/asm/22070.o(.bss);
        build/asm/22B30.o(.bss);
        build/asm/22B70.o(.bss);
        build/asm/22BB0.o(.bss);
        build/asm/22C80.o(.bss);
        build/asm/22D10.o(.bss);
        build/asm/22D70.o(.bss);
        build/asm/22DD0.o(.bss);
        build/asm/22E30.o(.bss);
        build/asm/22EA0.o(.bss);
        build/asm/22F70.o(.bss);
        build/asm/22FD0.o(.bss);
        build/asm/23490.o(.bss);
        build/asm/23740.o(.bss);
        build/asm/237E0.o(.bss);
        build/asm/23980.o(.bss);
        build/asm/23B90.o(.bss);
        build/asm/23C50.o(.bss);
        build/asm/23C60.o(.bss);
        build/asm/245F0.o(.bss);
        build/asm/24A80.o(.bss);
        build/asm/24B30.o(.bss);
        build/asm/24C10.o(.bss);
        build/asm/253E0.o(.bss);
        build/asm/25480.o(.bss);
        build/asm/26120.o(.bss);
        build/asm/26420.o(.bss);
        build/asm/27080.o(.bss);
        build/asm/27190.o(.bss);
        build/asm/273D0.o(.bss);
        build/asm/27740.o(.bss);
        build/asm/278B0.o(.bss);
        build/asm/28140.o(.bss);
        build/asm/281D0.o(.bss);
        build/asm/282B0.o(.bss);
        build/asm/28A90.o(.bss);
        build/asm/28D00.o(.bss);
        build/asm/28D90.o(.bss);
        build/asm/28DB0.o(.bss);
        build/asm/28E60.o(.bss);
        build/asm/28EE0.o(.bss);
        build/asm/28F40.o(.bss);
        build/asm/28FA0.o(.bss);
        build/asm/293C0.o(.bss);
        build/asm/29500.o(.bss);
        build/asm/29510.o(.bss);
        build/asm/29870.o(.bss);
        build/asm/29960.o(.bss);
        build/asm/29A60.o(.bss);
        build/asm/29E30.o(.bss);
        build/asm/2BC00.o(.bss);
        build/asm/2C010.o(.bss);
        build/asm/2C160.o(.bss);
        build/asm/2C1F0.o(.bss);
        build/asm/2C420.o(.bss);
        build/asm/2C560.o(.bss);
        build/asm/2C5F0.o(.bss);
        build/asm/2C690.o(.bss);
        build/asm/2C720.o(.bss);
        build/asm/2CFA0.o(.bss);
        build/asm/2CFB0.o(.bss);
        build/asm/2D2D0.o(.bss);
        build/asm/2D310.o(.bss);
        build/asm/2D3A0.o(.bss);
        build/asm/2D3D0.o(.bss);
        build/asm/2D400.o(.bss);
        build/asm/2D420.o(.bss);
        build/asm/2E070.o(.bss);
        build/asm/2E0F0.o(.bss);
        build/asm/2E120.o(.bss);
        build/asm/2E230.o(.bss);
        build/asm/2E240.o(.bss);
        build/asm/2E2A0.o(.bss);
        build/asm/2E2F0.o(.bss);
        build/asm/2E390.o(.bss);
        build/asm/2E3E0.o(.bss);
        build/asm/2EAE0.o(.bss);
        build/asm/data/40720.bss.o(.bss);
        . = ALIGN(., 16);
        main_BSS_END = .;
        main_BSS_SIZE = ABSOLUTE(main_BSS_END - main_BSS_START);
    }
    __romPos += SIZEOF(.main);
    __romPos = ALIGN(__romPos, 16);
    . = ALIGN(., 16);
    main_ROM_END = __romPos;
    main_VRAM_END = .;

    _40720_ROM_START = __romPos;
    _40720_VRAM = ADDR(._40720);
    ._40720 main_VRAM_END : AT(_40720_ROM_START) SUBALIGN(16)
    {
        FILL(0x00000000);
        _40720_DATA_START = .;
        build/assets/40720.o(.data);
        _40720_DATA_END = .;
        _40720_DATA_SIZE = ABSOLUTE(_40720_DATA_END - _40720_DATA_START);
    }
    __romPos += SIZEOF(._40720);
    _40720_ROM_END = __romPos;
    _40720_VRAM_END = .;

    /DISCARD/ :
    {
        *(*);
    }
}
